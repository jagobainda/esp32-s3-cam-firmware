## main/Kconfig.projbuild
```kconfig
menu "Mirilla electronica"

    menu "Wi-Fi"

        config MIRILLA_WIFI_SSID
            string "SSID de la red Wi-Fi"
            default "DIGIFIBRA-nUe9"
            help
                Nombre de la red 2.4GHz a la que se conecta la camara.
                El ESP32-S3 no soporta 5GHz.

        config MIRILLA_WIFI_PASSWORD
            string "Contrasena de la red Wi-Fi"
            default "j3wPtVF9TMd7"
            help
                Dejar vacio para una red abierta.

        config MIRILLA_WIFI_MAX_RETRY
            int "Reintentos de conexion antes de esperar"
            default 10
            range 1 100
            help
                Tras agotar los reintentos se espera MIRILLA_WIFI_RETRY_DELAY_MS
                y se vuelve a empezar; nunca se abandona definitivamente.

        config MIRILLA_WIFI_RETRY_DELAY_MS
            int "Espera entre tandas de reintentos (ms)"
            default 5000
            range 500 120000

    endmenu

    menu "Servidor"

        config MIRILLA_SERVER_HOST
            string "IP o hostname del servidor"
            default "192.168.1.133"

        config MIRILLA_SERVER_PORT
            int "Puerto del servidor"
            default 8000
            range 1 65535

        config MIRILLA_SERVER_PATH
            string "Ruta del endpoint de subida"
            default "/frame"

        config MIRILLA_API_KEY
            string "Clave compartida enviada en la cabecera X-API-Key"
            default "mirilla-dev-key"

        config MIRILLA_HTTP_TIMEOUT_MS
            int "Timeout de la peticion HTTP (ms)"
            default 4000
            range 500 60000

    endmenu

    menu "Camara"

        choice MIRILLA_FRAME_SIZE
            prompt "Resolucion de captura"
            default MIRILLA_FRAMESIZE_FHD
            help
                FHD (1920x1080) es el objetivo del proyecto. HD (1280x720) es el
                respaldo si el ancho de banda Wi-Fi no sostiene los FPS objetivo.

            config MIRILLA_FRAMESIZE_FHD
                bool "1920x1080 (FHD)"
            config MIRILLA_FRAMESIZE_HD
                bool "1280x720 (HD)"
            config MIRILLA_FRAMESIZE_SVGA
                bool "800x600 (SVGA)"
        endchoice

        config MIRILLA_JPEG_QUALITY
            int "Calidad JPEG (0-63, menor = mas calidad y mas bytes)"
            default 12
            range 0 63

        config MIRILLA_FB_COUNT
            int "Numero de framebuffers"
            default 3
            range 1 4
            help
                Con 2 (doble buffer) el driver se queda sin buffer libre
                mientras la subida retiene uno, y captura y envio se serializan:
                medido en hardware, el tiempo de captura oscilaba entre 0 y 80ms.
                Con 3 la captura pasa a 0-1ms constantes. A 414KB por buffer
                caben de sobra en los 8MB de PSRAM Octal.

        config MIRILLA_DISABLE_NIGHT_MODE
            bool "Desactivar el modo nocturno del OV5640"
            default y
            help
                El modo nocturno (registro 0x3a00 bit 2) alarga el tiempo de
                exposicion en escenas oscuras insertando lineas de relleno, lo
                que hunde el frame rate a ~4 FPS aunque la red y el pixel clock
                den de sobra. Para una mirilla interesa ritmo constante mas que
                una imagen limpia, asi que por defecto se desactiva.

        config MIRILLA_XCLK_FREQ_HZ
            int "Frecuencia XCLK del sensor (Hz)"
            default 20000000
            help
                20MHz es el valor verificado en la configuracion oficial de
                Waveshare para esta placa. Bajarlo puede ayudar si aparece
                corrupcion de imagen a resoluciones altas.

    endmenu

    menu "Captura"

        config MIRILLA_CAPTURE_BENCHMARK_S
            int "Benchmark de captura pura al arrancar (s, 0 = desactivado)"
            default 6
            range 0 60
            help
                Antes de levantar el Wi-Fi mide cuantos frames por segundo da el
                sensor sin subir nada. Sirve para distinguir de un vistazo si un
                FPS bajo viene de la camara o de la red.

        config MIRILLA_TARGET_FPS
            int "FPS objetivo"
            default 5
            range 1 30
            help
                El bucle de captura respeta este ritmo como maximo. Si la red
                o el sensor no dan para tanto, el FPS real medido sera menor.

        config MIRILLA_STATS_WINDOW_S
            int "Ventana de la estadistica de FPS (s)"
            default 5
            range 1 60

    endmenu

endmenu
```

## sdkconfig.defaults
```kconfig
CONFIG_IDF_TARGET="esp32s3"

CONFIG_ESP_DEFAULT_CPU_FREQ_MHZ_240=y

CONFIG_ESPTOOLPY_FLASHMODE_QIO=y
CONFIG_ESPTOOLPY_FLASHFREQ_80M=y
CONFIG_ESPTOOLPY_FLASHSIZE_16MB=y
CONFIG_PARTITION_TABLE_SINGLE_APP_LARGE=y

CONFIG_SPIRAM=y
CONFIG_SPIRAM_MODE_OCT=y
CONFIG_SPIRAM_TYPE_AUTO=y
CONFIG_SPIRAM_SPEED_80M=y
CONFIG_SPIRAM_USE_MALLOC=y
CONFIG_SPIRAM_MALLOC_ALWAYSINTERNAL=4096
CONFIG_SPIRAM_TRY_ALLOCATE_WIFI_LWIP=y
CONFIG_SPIRAM_IGNORE_NOTFOUND=n

CONFIG_ESP_MAIN_TASK_STACK_SIZE=6144
CONFIG_ESP_TASK_WDT_TIMEOUT_S=10

CONFIG_ESP_WIFI_STATIC_TX_BUFFER_NUM=16
CONFIG_ESP_WIFI_DYNAMIC_TX_BUFFER_NUM=64
CONFIG_ESP_WIFI_DYNAMIC_RX_BUFFER_NUM=64
CONFIG_ESP_WIFI_TX_BA_WIN=16
CONFIG_ESP_WIFI_RX_BA_WIN=16

CONFIG_LWIP_TCP_SND_BUF_DEFAULT=65535
CONFIG_LWIP_TCP_WND_DEFAULT=65535
CONFIG_LWIP_TCP_RECVMBOX_SIZE=64

CONFIG_OV5640_SUPPORT=y
CONFIG_SCCB_HARDWARE_I2C_PORT0=y

CONFIG_LOG_DEFAULT_LEVEL_INFO=y
```
